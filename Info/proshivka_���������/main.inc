
_3:
	.DB  0x1,0x0
	.DEF _i=R4
_4:
	.DB  0x1,0x0
	.DEF _T0=R6
_5:
	.DB  0x3,0x0
	.DEF _Kp=R8
_6:
	.DB  0x46,0x0
__fround_G2:
	.DB  0x48,0xE1,0xFA,0x3E,0xCD,0xCC,0x4C,0x3D
	.DB  0xA,0xD7,0xA3,0x3B,0x6F,0x12,0x3,0x3A
	.DB  0x17,0xB7,0x51,0x38,0xAC,0xC5,0xA7,0x36
_222:
	.DB  0x80,0xC0
	.DEF __lcd_x=R10
	.DEF __lcd_y=R11
	.DEF __lcd_maxx=R12
_0:
	.DB  0x20,0x20,0x20,0x20,0x20,0x20,0x20,0x20
	.DB  0x0,0x54,0x70,0x20,0x25,0x69,0x3A,0x20
	.DB  0x20,0x20,0x0,0x25,0x30,0x33,0x69,0x20
	.DB  0x20,0x20,0x20,0x20,0x0,0x54,0x63,0x3D
	.DB  0x25,0x30,0x33,0x69,0x20,0x54,0x0,0x70
	.DB  0x3D,0x25,0x30,0x33,0x69,0x20,0x50,0x25
	.DB  0x69,0x0

__GLOBAL_INI_TBL:
	.DW  0x09
	.DW  _lcd_buffer1
	.DW  _0*2

	.DW  0x09
	.DW  _lcd_buffer2
	.DW  _0*2

	.DW  0x02
	.DW  _program
	.DW  _3*2

	.DW  0x02
	.DW  0x04
	.DW  _4*2

	.DW  0x02
	.DW  0x06
	.DW  _5*2

	.DW  0x02
	.DW  0x08
	.DW  _6*2

	.DW  0x02
	.DW  __base_y_G4
	.DW  _222*2

	.DW  0
_0xED:
