
	.DEF _rx_wr_index=R5
	.DEF _rx_counter=R4
_6:
	.DB  0x73
_7:
	.DB  0x4B
_8:
	.DB  0x69
_9:
	.DB  0x41
_10:
	.DB  0x4
_11:
	.DB  0x1E
_12:
	.DB  0xA
_13:
	.DB  0x1
_14:
	.DB  0x1
	.DEF _zadergka_pri_nagatii=R7
_15:
	.DB  0xC8
	.DEF _zadergka_zastavka=R8
_16:
	.DB  0xE8,0x3
	.DEF _t_puskatel=R6
_17:
	.DB  0x64
_tbl10_G2:
	.DB  0x10,0x27,0xE8,0x3,0x64,0x0,0xA,0x0
	.DB  0x1,0x0
_tbl16_G2:
	.DB  0x0,0x10,0x0,0x1,0x10,0x0,0x1,0x0
_341:
	.DB  0x80,0xC0
	.DEF __lcd_x=R11
	.DEF __lcd_y=R10
	.DEF __lcd_maxx=R13
_350:
	.DW  0x00
_0:
	.DB  0x4B,0x6F,0xBE,0xBF,0xB8,0xBB,0xC4,0xBD
	.DB  0xC7,0x0,0x76,0x2E,0x32,0x2E,0x30,0x20
	.DB  0x72,0x75,0x0,0x4D,0x61,0xBA,0x63,0x20
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	.DB  0x75,0x61,0x0

__GLOBAL_INI_TBL:
	.DW  0x01
	.DW  _t_max_razogrev
	.DW  _6*2

	.DW  0x01
	.DW  _t_max_rabochee
	.DW  _7*2

	.DW  0x01
	.DW  _t_min_razogrev
	.DW  _8*2

	.DW  0x01
	.DW  _t_min_rabochee
	.DW  _9*2

	.DW  0x01
	.DW  _time_rabota_ch
	.DW  _10*2

	.DW  0x01
	.DW  _time_rabota_min
	.DW  _11*2

	.DW  0x01
	.DW  _time_smoke_min
	.DW  _12*2

	.DW  0x01
	.DW  _regim_rabot
	.DW  _13*2

	.DW  0x01
	.DW  _regim_rabot_old
	.DW  _14*2

	.DW  0x01
	.DW  0x07
	.DW  _15*2

	.DW  0x02
	.DW  0x08
	.DW  _16*2

	.DW  0x01
	.DW  0x06
	.DW  _17*2

	.DW  0x02
	.DW  __base_y_G3
	.DW  _341*2

	.DW  0x02
	.DW  _p_S61
	.DW  _350*2

	.DW  0
_0x16A:
